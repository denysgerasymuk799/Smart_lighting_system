# CY8C4248FLI_BL583 register map
File version: 0.1
PSoC 4200 BLE
Registers are 32-bit, read-write, no defined reset value unless marked. A register's access mark holds for its fields unless they carry their own. Offsets are from the block's base; lines under a group give offsets from that group; [hi:lo] are bit positions; {n}, {i} and the like mark numbered series; 'fields as' and 'values as' point back to an identical list; <NAME> marks a mode.

## Memory map
0x00000000 Timer_Heart_beat
0x00000000 Timer_Is_Free
0x00000000 Timer_Waiting_Time
0x00000000 DMAC — DMAC Registers
0x00000000 Timer_Change_Color
0x00000000 PrISM_1 — PrISM
0x00000000 UART — Serial Communication Block
0x00000000 PrISM_2 — PrISM

## Timer_Heart_beat
Base 0x00000000
0x40200108 COUNTER — Current counter value
0x4020010C CC — Compare / capture value
0x40200110 CC_BUF — Compare / capture buffer value
0x40200114 PERIOD — Period value
0x40200118 PERIOD_BUF — Period buffer value

## Timer_Is_Free
Base 0x00000000
0x402001C8 COUNTER — Current counter value
0x402001CC CC — Compare / capture value
0x402001D0 CC_BUF — Compare / capture buffer value
0x402001D4 PERIOD — Period value
0x402001D8 PERIOD_BUF — Period buffer value

## Timer_Waiting_Time
Base 0x00000000
0x40200148 COUNTER — Current counter value
0x4020014C CC — Compare / capture value
0x40200150 CC_BUF — Compare / capture buffer value
0x40200154 PERIOD — Period value
0x40200158 PERIOD_BUF — Period buffer value

## Timer_Change_Color
Base 0x00000000
0x40200188 COUNTER — Current counter value
0x4020018C CC — Compare / capture value
0x40200190 CC_BUF — Compare / capture buffer value
0x40200194 PERIOD — Period value
0x40200198 PERIOD_BUF — Period buffer value

## PrISM_1 — PrISM
Base 0x00000000
0x400F0003 PrISM_SEED 8-bit — Current seed value
0x400F0013 PrISM_POLYNOM 8-bit — Polynomial
0x400F0023 PrISM_DENSITY0 8-bit — Pulse Density 0
0x400F0033 PrISM_DENSITY1 8-bit — Pulse Density 1
0x400F0043 PrISM_SEED_COPY 8-bit — Start seed value
0x400F0073 PrISM_CONTROL 3-bit — Control register
  [2] compare_type1 — XX
  [1] compare_type0
  [0] ctrl_enable

## PrISM_2 — PrISM
Base 0x00000000
0x400F0002 PrISM_SEED 8-bit — Current seed value
0x400F0012 PrISM_POLYNOM 8-bit — Polynomial
0x400F0022 PrISM_DENSITY0 8-bit — Pulse Density 0
0x400F0032 PrISM_DENSITY1 8-bit — Pulse Density 1
0x400F0042 PrISM_SEED_COPY 8-bit — Start seed value
0x400F0072 PrISM_CONTROL 3-bit — Control register
  [2] compare_type1 — XX
  [1] compare_type0
  [0] ctrl_enable
